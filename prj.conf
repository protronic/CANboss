## CMakeLists.txt
```
# Zephyr-Build des CANboss-Monitors (der POSIX/Linux-Build laeuft
# weiterhin ueber das Makefile).
#
#   west build -b native_sim/native/64 CANboss
#   ./build/zephyr/zephyr.exe                    # --help fuer native_sim-Optionen

cmake_minimum_required(VERSION 3.20.0)
find_package(Zephyr REQUIRED HINTS $ENV{ZEPHYR_BASE})
project(canboss LANGUAGES C)

# Generierte Knotentabellen (make gen / tools/eds2tui.py)
file(GLOB canboss_gen_sources ${CMAKE_CURRENT_SOURCE_DIR}/src/gen/canboss_net_*.c)

target_sources(app PRIVATE
    src/main_zephyr.c
    src/ui.c
    src/tui.c
    src/tui_io_zephyr.c
    src/can_if.c
    src/can_zephyr.c
    src/co_node.c
    src/osal_zephyr.c
    src/sdo_value.c
    ${canboss_gen_sources}
    port/CO_driver.c
    od/canboss_master.c
    # CANopenNode-Stack (Submodul, protronic-Fork); nicht benoetigte
    # Module (LSS, LEDs, SRDO, Gateway) sind per CO_CONFIG in
    # port/CO_driver_target.h deaktiviert.
    CANopenNode/CANopen.c
    CANopenNode/301/CO_ODinterface.c
    CANopenNode/301/CO_NMT_Heartbeat.c
    CANopenNode/301/CO_HBconsumer.c
    CANopenNode/301/CO_Emergency.c
    CANopenNode/301/CO_SDOserver.c
    CANopenNode/301/CO_SDOclient.c
    CANopenNode/301/CO_PDO.c
    CANopenNode/301/CO_SYNC.c
    CANopenNode/301/CO_TIME.c
    CANopenNode/301/CO_fifo.c
    CANopenNode/301/crc16-ccitt.c
)

target_include_directories(app PRIVATE
    src
    src/gen
    port
    od
    CANopenNode
)
```

## west.yml
```
# West-Manifest: CANboss-Monorepo als Zephyr-Workspace (T2-Topologie,
# dieses Repo ist das Manifest-Repository).
#
# Einrichtung:
#   mkdir canboss-workspace && cd canboss-workspace
#   west init -m git@github.com:protronic/CANboss.git
#   west update
#   git -C CANboss submodule update --init
#
# Bereits geklont? Workspace um den Klon herum anlegen:
#   cd <verzeichnis-ueber-dem-klon>
#   west init -l CANboss && west update
#
# Apps (alle: west build -b native_sim/native/64 CANboss/apps/<name>):
#   apps/monitor        Terminal-Monitor (TUI; auch POSIX-Build via make)
#   apps/touch          LVGL-Touchpanel (native_sim + stm32h573i_dk)
#   apps/nodes/demo_*   Demo-Knoten (IO/Antrieb/Klimasensor) fuer vcan-Tests

manifest:
  self:
    path: CANboss

  remotes:
    - name: zephyrproject-rtos
      url-base: git@github.com:zephyrproject-rtos

  projects:
    - name: zephyr
      remote: zephyrproject-rtos
      revision: v4.4.2
      path: zephyr
      west-commands: scripts/west-commands.yml
    # LVGL 9.5 (Pin Zephyr v4.4.2); CMDB-Guards nicht noetig (App-seitig flach + async CAN)
    - name: lvgl
      remote: zephyrproject-rtos
      revision: 85aa60d18b3d5e5588d7b247abf90198f07c8a63
      path: modules/lib/gui/lvgl
    # fuer Hardware-Targets (stm32h573i_dk); Revisionen = Zephyr v4.4.2
    - name: cmsis
      remote: zephyrproject-rtos
      revision: 512cc7e895e8491696b61f7ba8066b4a182569b8
      path: modules/hal/cmsis
    - name: cmsis_6
      remote: zephyrproject-rtos
      repo-path: CMSIS_6
      revision: 30a859f44ef8ab4dc8f84b03ed586fd16ccf9d74
      path: modules/hal/cmsis_6
    - name: hal_stm32
      remote: zephyrproject-rtos
      revision: fc11896dd39cfca37bf9b4aeaaa2df8861b81875
      path: modules/hal/stm32
    # RTT-Logging in der Debug-Session (probe-rs / Cortex-Debug)
    - name: segger
      remote: zephyrproject-rtos
      revision: 50892fdbcf2f570e67baa72b8894a66b16946f72
      path: modules/debug/segger
```

## prj.conf
```kconfig
# Zephyr-Konfiguration des CANboss-Monitors

CONFIG_CAN=y

# UI + SDO-Transfers laufen im Main-Thread; CAN-RX und CANopen-Mainline
# sind eigene k_threads (src/osal_zephyr.c, statische Stacks).
CONFIG_MAIN_STACK_SIZE=16384

# Kein Boot-Banner in die TUI drucken
CONFIG_BOOT_BANNER=n
```

## boards/native_sim_native_64.conf
```kconfig
CONFIG_SERIAL=y
# native_sim: UART-Konsole direkt auf stdin/stdout des Host-Prozesses,
# damit die TUI im Terminal laeuft (./build/zephyr/zephyr.exe).
CONFIG_UART_NATIVE_POSIX=y
CONFIG_NATIVE_UART_0_ON_STDINOUT=y
CONFIG_UART_CONSOLE=y
```

## src/main.c
```c
/**
 * main.c
 *
 * CANboss - CANopen-Parametermonitor mit Terminal-UI (C-Port von
 * CANboss-rs). Statt CouchDB-Discovery und GTWA-Serial-Gateway nutzt
 * der Port die aus den EDS-Dateien generierten Tabellen (src/gen/)
 * und spricht CANopen direkt ueber CANopenNode - zunaechst ueber
 * SocketCAN, spaeter auch ueber einen seriellen CAN-Adapter
 * (--backend serial, siehe src/can_serial.c).
 */

#include <getopt.h>
#include <stdio.h>
#include <stdlib.h>
#include <string.h>

#include "canboss.h"
#include "canboss_net.h"
#include "can_if.h"
#include "co_node.h"
#include "ui.h"

static void
usage(const char* prog) {
    printf("CANboss - CANopen-Parametermonitor (C-Port von CANboss-rs)\n"
           "\n"
           "Aufruf: %s [Optionen]\n"
           "\n"
           "  --backend <name>   CAN-Backend: socketcan (Default) | serial (geplant)\n"
           "  --can <iface>      CAN-Interface bzw. Geraet (Default: can0)\n"
           "  --bitrate <bps>    Bitrate fuer Backends, die sie selbst setzen\n"
           "                     (SocketCAN uebernimmt sie vom Interface)\n"
           "  --node <id>        Knoten aus eds/network.json direkt oeffnen\n"
           "  --node-id <id>     eigene Node-ID des Monitors (Default: %u)\n"
           "  --offline          ohne CAN-Verbindung starten (nur Browsen)\n"
           "  --list             bekannte Knoten ausgeben und beenden\n"
           "  --help             diese Hilfe\n"
           "\n"
           "Beispiele:\n"
           "  %s --can vcan0                 Netzwerk-Browser auf vcan0\n"
           "  %s --can can0 --node 16        Monitor fuer Node 16 (IO-Modul)\n"
           "  %s --offline                   Datenpunkte ohne Bus ansehen\n",
           prog, CB_CO_NODE_ID_DEFAULT, prog, prog, prog);
}

static void
list_nodes(void) {
    printf("Knoten aus eds/network.json (einkompiliert via tools/eds2tui.py):\n");
    for (uint16_t i = 0; i < cb_net_node_count; i++) {
        const cb_node_desc_t* n = cb_net_nodes[i];
        printf("  Node %3u  %-16s %-20s %u Objekte, %u Datenpunkte\n", n->node_id, n->name, n->eds_file, n->obj_count,
               n->dp_count);
    }
}

int
main(int argc, char** argv) {
    const char* backend_name = "socketcan";
    const char* device = "can0";
    uint32_t bitrate = 125000;
    int start_node = 0;
    int own_node_id = CB_CO_NODE_ID_DEFAULT;
    bool offline = false;

    static const struct option opts[] = {
        {"backend", required_argument, NULL, 'B'},
        {"can", required_argument, NULL, 'c'},
        {"bitrate", required_argument, NULL, 'b'},
        {"node", required_argument, NULL, 'n'},
        {"node-id", required_argument, NULL, 'i'},
        {"offline", no_argument, NULL, 'o'},
        {"list", no_argument, NULL, 'l'},
        {"help", no_argument, NULL, 'h'},
        {NULL, 0, NULL, 0},
    };

    int opt;
    while ((opt = getopt_long(argc, argv, "h", opts, NULL)) != -1) {
        switch (opt) {
            case 'B': backend_name = optarg; break;
            case 'c': device = optarg; break;
            case 'b': bitrate = (uint32_t)strtoul(optarg, NULL, 0); break;
            case 'n': start_node = atoi(optarg); break;
            case 'i': own_node_id = atoi(optarg); break;
            case 'o': offline = true; break;
            case 'l': list_nodes(); return 0;
            case 'h': usage(argv[0]); return 0;
            default: usage(argv[0]); return 1;
        }
    }

    if (own_node_id < 1 || own_node_id > 127) {
        fprintf(stderr, "Ungueltige eigene Node-ID %d (1..127)\n", own_node_id);
        return 1;
    }

    char can_label[128];
    snprintf(can_label, sizeof(can_label), "%s/%s", backend_name, device);

    if (!offline) {
        const cb_can_backend_t* backend = cb_can_backend_find(backend_name);
        if (backend == NULL) {
            fprintf(stderr, "Unbekanntes Backend '%s'. Verfuegbar:", backend_name);
            for (const char* const* n = cb_can_backend_names(); *n != NULL; n++) {
                fprintf(stderr, " %s", *n);
            }
            fprintf(stderr, "\n");
            return 1;
        }
        if (cb_co_start(backend, device, bitrate, (uint8_t)own_node_id) != 0) {
            /* wie das Rust-Original: Fehler melden und offline weiter */
            fprintf(stderr, "Warnung: %s - starte im Offline-Modus\n", cb_co_error());
        }
    }

    int ret = cb_ui_run(start_node, can_label);

    cb_co_stop();
    return ret == 0 ? 0 : 1;
}
```

## src/can_if.c
```c
/**
 * can_if.c
 *
 * Registry der CAN-Backends. Neue Backends (z.B. weitere serielle
 * Protokolle) hier eintragen.
 */

#include "can_if.h"

#include <stddef.h>
#include <string.h>

extern const cb_can_backend_t cb_can_socketcan;
extern const cb_can_backend_t cb_can_serial;

static const cb_can_backend_t* const cb_backends[] = {
    &cb_can_socketcan,
    &cb_can_serial,
};

static const char* cb_backend_name_list[sizeof(cb_backends) / sizeof(cb_backends[0]) + 1];

const cb_can_backend_t*
cb_can_backend_find(const char* name) {
    if (name == NULL) {
        return NULL;
    }
    for (size_t i = 0; i < sizeof(cb_backends) / sizeof(cb_backends[0]); i++) {
        if (strcmp(cb_backends[i]->name, name) == 0) {
            return cb_backends[i];
        }
    }
    return NULL;
}

const char* const*
cb_can_backend_names(void) {
    for (size_t i = 0; i < sizeof(cb_backends) / sizeof(cb_backends[0]); i++) {
        cb_backend_name_list[i] = cb_backends[i]->name;
    }
    cb_backend_name_list[sizeof(cb_backends) / sizeof(cb_backends[0])] = NULL;
    return cb_backend_name_list;
}
```

## src/can_zephyr.c
```c
/**
 * can_zephyr.c
 *
 * CAN-Backend auf der Zephyr-CAN-API (chosen zephyr,canbus).
 *
 * Auf native_sim bindet der Treiber "zephyr,native-linux-can" das
 * Host-SocketCAN-Interface an (boards/native_sim.overlay:
 * host-interface = "vcan0") - damit entspricht der native_sim-Build
 * funktional der POSIX-SocketCAN-Variante. Auf Hardware haengt hier
 * der jeweilige CAN-Controller aus dem Devicetree.
 */

#include "can_if.h"

#include <errno.h>
#include <string.h>

#include <zephyr/device.h>
#include <zephyr/drivers/can.h>
#include <zephyr/kernel.h>

CAN_MSGQ_DEFINE(cb_can_rx_msgq, 64);

static const struct device* const cb_can_dev = DEVICE_DT_GET(DT_CHOSEN(zephyr_canbus));
static int cb_filter_id = -1;

static int
zephyr_open(const char* device, uint32_t bitrate) {
    int ret;

    (void)device; /* Geraet kommt aus dem Devicetree (chosen zephyr,canbus) */

    if (!device_is_ready(cb_can_dev)) {
        errno = ENODEV;
        return -1;
    }

    if (bitrate > 0) {
        struct can_timing timing;
        if (can_calc_timing(cb_can_dev, &timing, bitrate, 875) >= 0) {
            /* Fehler ignorieren: native-linux-can uebernimmt die
             * Bitrate vom Host-Interface */
            (void)can_set_timing(cb_can_dev, &timing);
        }
    }

    ret = can_start(cb_can_dev);
    if (ret != 0 && ret != -EALREADY) {
        errno = -ret;
        return -1;
    }

    /* Alle klassischen 11-Bit-Frames empfangen; verteilt wird in
     * CO_CANrxDispatch (Software-Filter des CANopenNode-Ports). */
    struct can_filter filter = {
        .id = 0,
        .mask = 0,
        .flags = 0,
    };
    cb_filter_id = can_add_rx_filter_msgq(cb_can_dev, &cb_can_rx_msgq, &filter);
    if (cb_filter_id < 0) {
        errno = -cb_filter_id;
        (void)can_stop(cb_can_dev);
        return -1;
    }

    return 0;
}

static void
zephyr_close(void) {
    if (cb_filter_id >= 0) {
        can_remove_rx_filter(cb_can_dev, cb_filter_id);
        cb_filter_id = -1;
    }
    (void)can_stop(cb_can_dev);
}

static int
zephyr_send(const cb_can_frame_t* frame) {
    struct can_frame zf;
    int ret;

    memset(&zf, 0, sizeof(zf));
    zf.id = frame->id;
    zf.dlc = frame->dlc > 8 ? 8 : frame->dlc;
    if (frame->rtr) {
        zf.flags |= CAN_FRAME_RTR;
    }
    memcpy(zf.data, frame->data, zf.dlc);

    ret = can_send(cb_can_dev, &zf, K_MSEC(100), NULL, NULL);
    if (ret != 0) {
        errno = -ret;
        return -1;
    }
    return 0;
}

static int
zephyr_recv(cb_can_frame_t* frame, int timeout_ms) {
    struct can_frame zf;
    k_timeout_t timeout = timeout_ms < 0 ? K_FOREVER : K_MSEC(timeout_ms);

    if (k_msgq_get(&cb_can_rx_msgq, &zf, timeout) != 0) {
        return 0;
    }
    if ((zf.flags & (CAN_FRAME_IDE | CAN_FRAME_FDF)) != 0) {
        return 0; /* nur klassische 11-Bit-Frames */
    }

    frame->id = (uint16_t)(zf.id & 0x7FFu);
    frame->rtr = (zf.flags & CAN_FRAME_RTR) != 0;
    frame->dlc = zf.dlc > 8 ? 8 : zf.dlc;
    memcpy(frame->data, zf.data, frame->dlc);
    return 1;
}

const cb_can_backend_t cb_can_zephyr = {
    .name = "zephyr",
    .open = zephyr_open,
    .close = zephyr_close,
    .send = zephyr_send,
    .recv = zephyr_recv,
};
```

## src/co_node.c
```c
/**
 * co_node.c
 *
 * CANopenNode-Stack-Anbindung: Initialisierung nach dem Muster von
 * CANopenNode/example/main_blank.c (CO_MULTIPLE_OD mit dem generierten
 * Objektverzeichnis od/canboss_master.h), dazu zwei Threads:
 *
 *   - RX-Thread:       Backend-recv() -> CO_CANrxDispatch()
 *   - Mainline-Thread: CO_process() + SYNC/RPDO/TPDO im 1-ms-Raster
 *
 * Die blockierenden SDO-Transfers (cb_co_sdo_read/_write) laufen im
 * Aufruferthread (UI) und sind untereinander per Mutex serialisiert -
 * dasselbe Muster wie der SDO-Worker in CANbossTouch/App/canboss_sdo.c.
 */

#include "co_node.h"
#include "osal.h"

#include <errno.h>
#include <stdio.h>
#include <string.h>

#include "CANopen.h"
#include "301/CO_SDOclient.h"
#include "canboss_master.h"

#define CB_CO_MAINLINE_INTERVAL_US 1000u
#define CB_CO_RX_TIMEOUT_MS        1
#define CB_CO_FIRST_HB_TIME_MS     500u
#define CB_CO_SDO_SRV_TIMEOUT_MS   1000u

static CO_t* cb_co = NULL;
static const cb_can_backend_t* cb_backend = NULL;
static volatile bool cb_running = false;
static char cb_error_text[256];

/* RX-Thread: Frames vom Backend an den Stack verteilen */
static void
cb_rx_loop(void* arg) {
    (void)arg;
    cb_can_frame_t frame;
    CO_CANrxMsg_t msg;

    while (cb_running) {
        int ret = cb_backend->recv(&frame, CB_CO_RX_TIMEOUT_MS);
        if (ret < 0) {
            /* Backend weg (Interface down o.ae.): kurz warten */
            cb_sleep_us(10000);
            continue;
        }
        if (ret == 0 || frame.rtr) {
            continue;
        }
        msg.ident = frame.id;
        msg.DLC = frame.dlc;
        memcpy(msg.data, frame.data, sizeof(msg.data));
        CO_CANrxDispatch(cb_co->CANmodule, &msg);
    }
}

/* Mainline-Thread: zyklische Stack-Verarbeitung */
static void
cb_mainline_loop(void* arg) {
    (void)arg;
    uint64_t last = cb_now_us();

    while (cb_running) {
        cb_sleep_us(CB_CO_MAINLINE_INTERVAL_US);
        uint64_t now = cb_now_us();
        uint32_t diff_us = (uint32_t)(now - last);
        last = now;

        /* NMT-Reset-Kommandos vom Bus ignoriert der Monitor bewusst:
         * er ist Beobachter und startet nicht neu. */
        (void)CO_process(cb_co, false, diff_us, NULL);

        CO_LOCK_OD(cb_co->CANmodule);
        if (!cb_co->nodeIdUnconfigured && cb_co->CANmodule->CANnormal) {
            bool_t syncWas = false;
#if (CO_CONFIG_SYNC) & CO_CONFIG_SYNC_ENABLE
            syncWas = CO_process_SYNC(cb_co, diff_us, NULL);
#endif
#if (CO_CONFIG_PDO) & CO_CONFIG_RPDO_ENABLE
            CO_process_RPDO(cb_co, syncWas, diff_us, NULL);
#endif
#if (CO_CONFIG_PDO) & CO_CONFIG_TPDO_ENABLE
            CO_process_TPDO(cb_co, syncWas, diff_us, NULL);
#endif
        }
        CO_UNLOCK_OD(cb_co->CANmodule);
    }
}

static int
cb_fail(const char* fmt, int code) {
    snprintf(cb_error_text, sizeof(cb_error_text), fmt, code);
    return -1;
}

int
cb_co_start(const cb_can_backend_t* backend, const char* device, uint32_t bitrate, uint8_t own_node_id) {
    CO_ReturnError_t err;
    uint32_t errInfo = 0;
    uint32_t heapUsed = 0;

    cb_error_text[0] = '\0';

    if (backend == NULL || device == NULL) {
        snprintf(cb_error_text, sizeof(cb_error_text), "kein CAN-Backend/Geraet angegeben");
        return -1;
    }

    if (backend->open(device, bitrate) != 0) {
        snprintf(cb_error_text, sizeof(cb_error_text), "%s '%s' oeffnen fehlgeschlagen: %s", backend->name, device,
                 strerror(errno));
        return -1;
    }
    cb_backend = backend;

    /* OD-Konfiguration aus dem generierten canboss_master-Verzeichnis */
    static CO_config_t co_config;
    memset(&co_config, 0, sizeof(co_config));
    canboss_master_INIT_CONFIG(co_config);

    cb_co = CO_new(&co_config, &heapUsed);
    if (cb_co == NULL) {
        backend->close();
        snprintf(cb_error_text, sizeof(cb_error_text), "CO_new: keine Speicherzuteilung");
        return -1;
    }

    err = CO_CANinit(cb_co, (void*)(uintptr_t)backend, 0 /* Bitrate macht das Backend */);
    if (err != CO_ERROR_NO) {
        CO_delete(cb_co);
        cb_co = NULL;
        backend->close();
        return cb_fail("CO_CANinit fehlgeschlagen: %d", (int)err);
    }

    err = CO_CANopenInit(cb_co, NULL, NULL, canboss_master, NULL,
                         CO_NMT_STARTUP_TO_OPERATIONAL | CO_NMT_ERR_ON_ERR_REG | CO_ERR_REG_GENERIC_ERR
                             | CO_ERR_REG_COMMUNICATION,
                         CB_CO_FIRST_HB_TIME_MS, CB_CO_SDO_SRV_TIMEOUT_MS, CB_CO_SDO_TIMEOUT_MS, false, own_node_id,
                         &errInfo);
    if (err != CO_ERROR_NO) {
        CO_delete(cb_co);
        cb_co = NULL;
        backend->close();
        if (err == CO_ERROR_OD_PARAMETERS) {
            return cb_fail("CO_CANopenInit: OD-Eintrag 0x%X fehlerhaft", (int)errInfo);
        }
        return cb_fail("CO_CANopenInit fehlgeschlagen: %d", (int)err);
    }

    err = CO_CANopenInitPDO(cb_co, cb_co->em, canboss_master, own_node_id, &errInfo);
    if (err != CO_ERROR_NO) {
        CO_delete(cb_co);
        cb_co = NULL;
        backend->close();
        return cb_fail("CO_CANopenInitPDO fehlgeschlagen: %d", (int)err);
    }

    CO_CANsetNormalMode(cb_co->CANmodule);

    cb_running = true;
    if (cb_thread_start(CB_THREAD_CAN_RX, cb_rx_loop, NULL) != 0
        || cb_thread_start(CB_THREAD_MAINLINE, cb_mainline_loop, NULL) != 0) {
        cb_running = false;
        CO_delete(cb_co);
        cb_co = NULL;
        backend->close();
        snprintf(cb_error_text, sizeof(cb_error_text), "Threads starten fehlgeschlagen");
        return -1;
    }

    return 0;
}

void
cb_co_stop(void) {
    if (!cb_running) {
        return;
    }
    cb_running = false;
    cb_thread_join(CB_THREAD_CAN_RX);
    cb_thread_join(CB_THREAD_MAINLINE);
    CO_CANmodule_disable(cb_co->CANmodule);
    CO_delete(cb_co);
    cb_co = NULL;
    if (cb_backend != NULL) {
        cb_backend->close();
        cb_backend = NULL;
    }
}

bool
cb_co_connected(void) {
    return cb_running && cb_co != NULL && !cb_co->nodeIdUnconfigured;
}

const char*
cb_co_error(void) {
    return cb_error_text;
}

/* Blockierender SDO-Upload, Muster aus 301/CO_SDOclient.h bzw.
 * CANbossTouch/App/canboss_sdo.c */
static CO_SDO_abortCode_t
cb_read_SDO(CO_SDOclient_t* SDO_C, uint8_t nodeId, uint16_t index, uint8_t subIndex, uint8_t* buf, size_t bufSize,
            size_t* readSize) {
    CO_SDO_return_t SDO_ret;

    SDO_ret = CO_SDOclient_setup(SDO_C, CO_CAN_ID_SDO_CLI + nodeId, CO_CAN_ID_SDO_SRV + nodeId, nodeId);
    if (SDO_ret != CO_SDO_RT_ok_communicationEnd) {
        return CO_SDO_AB_GENERAL;
    }

    SDO_ret = CO_SDOclientUploadInitiate(SDO_C, index, subIndex, CB_CO_SDO_TIMEOUT_MS, false);
    if (SDO_ret != CO_SDO_RT_ok_communicationEnd) {
        return CO_SDO_AB_GENERAL;
    }

    do {
        uint32_t timeDifference_us = 1000;
        CO_SDO_abortCode_t abortCode = CO_SDO_AB_NONE;

        SDO_ret = CO_SDOclientUpload(SDO_C, timeDifference_us, false, &abortCode, NULL, NULL, NULL);
        if (SDO_ret < 0) {
            return abortCode;
        }
        cb_sleep_us(1000);
    } while (SDO_ret > 0);

    *readSize = CO_SDOclientUploadBufRead(SDO_C, buf, bufSize);
    return CO_SDO_AB_NONE;
}

/* Blockierender SDO-Download, Muster wie oben */
static CO_SDO_abortCode_t
cb_write_SDO(CO_SDOclient_t* SDO_C, uint8_t nodeId, uint16_t index, uint8_t subIndex, const uint8_t* data,
             size_t dataSize) {
    CO_SDO_return_t SDO_ret;

    SDO_ret = CO_SDOclient_setup(SDO_C, CO_CAN_ID_SDO_CLI + nodeId, CO_CAN_ID_SDO_SRV + nodeId, nodeId);
    if (SDO_ret != CO_SDO_RT_ok_communicationEnd) {
        return CO_SDO_AB_GENERAL;
    }

    SDO_ret = CO_SDOclientDownloadInitiate(SDO_C, index, subIndex, dataSize, CB_CO_SDO_TIMEOUT_MS, false);
    if (SDO_ret != CO_SDO_RT_ok_communicationEnd) {
        return CO_SDO_AB_GENERAL;
    }

    if (CO_SDOclientDownloadBufWrite(SDO_C, data, dataSize) < dataSize) {
        /* Datenpunkte sind auf CB_DP_DATA_MAX begrenzt und passen in den
         * Clientpuffer; groessere Transfers werden nicht unterstuetzt. */
        return CO_SDO_AB_OUT_OF_MEM;
    }

    do {
        uint32_t timeDifference_us = 1000;
        CO_SDO_abortCode_t abortCode = CO_SDO_AB_NONE;

        SDO_ret = CO_SDOclientDownload(SDO_C, timeDifference_us, false, false, &abortCode, NULL, NULL);
        if (SDO_ret < 0) {
            return abortCode;
        }
        cb_sleep_us(1000);
    } while (SDO_ret > 0);

    return CO_SDO_AB_NONE;
}

int
cb_co_sdo_read(uint8_t node_id, uint16_t index, uint8_t sub, uint8_t* buf, size_t buf_size, size_t* read_size,
               uint32_t* abort_code) {
    if (!cb_co_connected() || cb_co->SDOclient == NULL) {
        *abort_code = 0;
        return -1;
    }

    cb_mutex_lock(CB_MUTEX_SDO);
    CO_SDO_abortCode_t abort = cb_read_SDO(&cb_co->SDOclient[0], node_id, index, sub, buf, buf_size, read_size);
    CO_SDOclientClose(&cb_co->SDOclient[0]);
    cb_mutex_unlock(CB_MUTEX_SDO);

    if (abort != CO_SDO_AB_NONE) {
        *abort_code = (uint32_t)abort;
        return -1;
    }
    return 0;
}

int
cb_co_sdo_write(uint8_t node_id, uint16_t index, uint8_t sub, const uint8_t* data, size_t len, uint32_t* abort_code) {
    if (!cb_co_connected() || cb_co->SDOclient == NULL) {
        *abort_code = 0;
        return -1;
    }

    cb_mutex_lock(CB_MUTEX_SDO);
    CO_SDO_abortCode_t abort = cb_write_SDO(&cb_co->SDOclient[0], node_id, index, sub, data, len);
    CO_SDOclientClose(&cb_co->SDOclient[0]);
    cb_mutex_unlock(CB_MUTEX_SDO);

    if (abort != CO_SDO_AB_NONE) {
        *abort_code = (uint32_t)abort;
        return -1;
    }
    return 0;
}

const char*
cb_co_abort_str(uint32_t abort_code) {
    switch (abort_code) {
        case 0: return "Timeout/lokaler Fehler";
        case 0x05030000: return "Toggle-Bit unveraendert";
        case 0x05040000: return "SDO-Timeout";
        case 0x05040001: return "Ungueltiges Kommando";
        case 0x06010000: return "Zugriff nicht unterstuetzt";
        case 0x06010001: return "Objekt nicht lesbar";
        case 0x06010002: return "Objekt nicht schreibbar";
        case 0x06020000: return "Objekt nicht vorhanden";
        case 0x06070010: return "Datenlaenge passt nicht";
        case 0x06070012: return "Datenlaenge zu gross";
        case 0x06070013: return "Datenlaenge zu klein";
        case 0x06090011: return "Subindex nicht vorhanden";
        case 0x06090030: return "Wertebereich verletzt";
        case 0x06090031: return "Wert zu gross";
        case 0x06090032: return "Wert zu klein";
        case 0x08000000: return "Allgemeiner Fehler";
        case 0x08000020: return "Datentransfer nicht moeglich";
        case 0x08000022: return "Geraetezustand verhindert Zugriff";
        default: {
            static char text[32];
            snprintf(text, sizeof(text), "SDO-Abort 0x%08X", abort_code);
            return text;
        }
    }
}
```

## src/co_node.h
```c
/**
 * co_node.h
 *
 * CANopenNode-Stack des CANboss-Monitors (Node 127, OD aus
 * od/canboss_master.h) plus blockierende SDO-Client-Transfers.
 *
 * Ersetzt die GTWA-Serial-Schicht des Rust-Originals
 * (serial_gtwa.rs/gtwa.rs): statt JSON-Kommandos an ein Gateway werden
 * SDO-Upload/-Download direkt ueber den Bus gefahren.
 */

#ifndef CB_CO_NODE_H_
#define CB_CO_NODE_H_

#include <stdint.h>
#include <stddef.h>
#include <stdbool.h>

#include "can_if.h"

#ifdef __cplusplus
extern "C" {
#endif

/* Node-ID des Monitors selbst (canboss_master.eds: Node 127) */
#define CB_CO_NODE_ID_DEFAULT 127u

/* Timeout eines einzelnen SDO-Transfers */
#define CB_CO_SDO_TIMEOUT_MS 500u

/* Stack starten: Backend oeffnen, CANopenNode initialisieren,
 * RX- und Mainline-Thread starten.
 * Rueckgabe 0 bei Erfolg, sonst -1 (Fehlertext via cb_co_error()). */
int cb_co_start(const cb_can_backend_t* backend, const char* device, uint32_t bitrate, uint8_t own_node_id);

/* Stack anhalten, Threads beenden, Backend schliessen. */
void cb_co_stop(void);

/* true, wenn der Stack laeuft (sonst Offline-Modus wie im Original). */
bool cb_co_connected(void);

/* Letzter Fehlertext von cb_co_start() */
const char* cb_co_error(void);

/* Blockierender SDO-Upload (lesen) vom entfernten Knoten.
 * Rueckgabe 0 bei Erfolg (*read_size gesetzt), sonst -1 und
 * *abort_code enthaelt den SDO-Abortcode (0 = lokaler Fehler). */
int cb_co_sdo_read(uint8_t node_id, uint16_t index, uint8_t sub, uint8_t* buf, size_t buf_size, size_t* read_size,
                   uint32_t* abort_code);

/* Blockierender SDO-Download (schreiben) zum entfernten Knoten. */
int cb_co_sdo_write(uint8_t node_id, uint16_t index, uint8_t sub, const uint8_t* data, size_t len,
                    uint32_t* abort_code);

/* SDO-Abortcode als Klartext (statischer Puffer). */
const char* cb_co_abort_str(uint32_t abort_code);

#ifdef __cplusplus
}
#endif

#endif /* CB_CO_NODE_H_ */
```

## src/main_zephyr.c
```c
/**
 * main_zephyr.c
 *
 * Einstieg des Zephyr-Builds (west build -b native_sim/native/64).
 *
 * Anders als der POSIX-Build (src/main.c, getopt) gibt es keine
 * Kommandozeile: das CAN-Geraet kommt aus dem Devicetree (chosen
 * zephyr,canbus), die eigene Node-ID aus CONFIG_CANBOSS_NODE_ID.
 * Schlaegt der CAN-Start fehl, laeuft die UI im Offline-Modus -
 * gleiches Verhalten wie das Rust-Original.
 */

#include <stdio.h>

#ifdef CONFIG_ARCH_POSIX
#include <nsi_main.h> /* nsi_exit(): native_sim-Prozess beenden */
#endif

#include "canboss.h"
#include "can_if.h"
#include "co_node.h"
#include "ui.h"

int
main(void) {
    const cb_can_backend_t* backend = cb_can_backend_find("zephyr");

    if (cb_co_start(backend, "zephyr,canbus", 0, CONFIG_CANBOSS_NODE_ID) != 0) {
        printf("Warnung: %s - starte im Offline-Modus\r\n", cb_co_error());
    }

    (void)cb_ui_run(0, "zephyr/can");

    cb_co_stop();

#ifdef CONFIG_ARCH_POSIX
    nsi_exit(0); /* sonst laeuft der Simulator nach 'q' weiter */
#endif
    return 0;
}
```

## src/osal.h
```c
/**
 * osal.h
 *
 * Minimale OS-Abstraktion des CANboss-Monitors: zwei Arbeitsthreads
 * (CAN-RX, CANopen-Mainline), Mutexe, monotone Zeit und Schlafen.
 *
 *   - osal_posix.c   Linux/POSIX: pthreads, clock_gettime, usleep
 *   - osal_zephyr.c  Zephyr: k_thread (statische Stacks), k_mutex,
 *                    k_uptime, k_sleep
 */

#ifndef CB_OSAL_H_
#define CB_OSAL_H_

#include <stdint.h>

#ifdef __cplusplus
extern "C" {
#endif

/* Feste Thread-Slots (statische Stacks im Zephyr-Build) */
#define CB_THREAD_CAN_RX   0
#define CB_THREAD_MAINLINE 1
#define CB_THREAD_COUNT    2

/* Feste Mutex-Slots */
#define CB_MUTEX_CAN_SEND 0
#define CB_MUTEX_EMCY     1
#define CB_MUTEX_OD       2
#define CB_MUTEX_SDO      3
#define CB_MUTEX_COUNT    4

/* Thread im Slot starten. Rueckgabe 0 bei Erfolg. */
int cb_thread_start(int slot, void (*fn)(void*), void* arg);

/* Auf Thread-Ende warten (Funktion fn ist zurueckgekehrt). */
void cb_thread_join(int slot);

void cb_mutex_lock(int slot);
void cb_mutex_unlock(int slot);

/* Monotone Zeit in Mikrosekunden */
uint64_t cb_now_us(void);

void cb_sleep_us(uint32_t us);

#ifdef __cplusplus
}
#endif

#endif /* CB_OSAL_H_ */
```

## src/osal_posix.c
```c
/**
 * osal_posix.c
 *
 * OS-Abstraktion fuer Linux/POSIX: pthreads, clock_gettime, usleep.
 */

#include "osal.h"

#include <pthread.h>
#include <time.h>
#include <unistd.h>

static pthread_t cb_threads[CB_THREAD_COUNT];

static pthread_mutex_t cb_mutexes[CB_MUTEX_COUNT] = {
    PTHREAD_MUTEX_INITIALIZER,
    PTHREAD_MUTEX_INITIALIZER,
    PTHREAD_MUTEX_INITIALIZER,
    PTHREAD_MUTEX_INITIALIZER,
};

typedef struct {
    void (*fn)(void*);
    void* arg;
} cb_thread_ctx_t;

static cb_thread_ctx_t cb_thread_ctx[CB_THREAD_COUNT];

static void*
cb_thread_trampoline(void* arg) {
    cb_thread_ctx_t* ctx = (cb_thread_ctx_t*)arg;
    ctx->fn(ctx->arg);
    return NULL;
}

int
cb_thread_start(int slot, void (*fn)(void*), void* arg) {
    if (slot < 0 || slot >= CB_THREAD_COUNT) {
        return -1;
    }
    cb_thread_ctx[slot].fn = fn;
    cb_thread_ctx[slot].arg = arg;
    return pthread_create(&cb_threads[slot], NULL, cb_thread_trampoline, &cb_thread_ctx[slot]) == 0 ? 0 : -1;
}

void
cb_thread_join(int slot) {
    if (slot >= 0 && slot < CB_THREAD_COUNT) {
        pthread_join(cb_threads[slot], NULL);
    }
}

void
cb_mutex_lock(int slot) {
    pthread_mutex_lock(&cb_mutexes[slot]);
}

void
cb_mutex_unlock(int slot) {
    pthread_mutex_unlock(&cb_mutexes[slot]);
}

uint64_t
cb_now_us(void) {
    struct timespec ts;
    clock_gettime(CLOCK_MONOTONIC, &ts);
    return (uint64_t)ts.tv_sec * 1000000ull + (uint64_t)ts.tv_nsec / 1000ull;
}

void
cb_sleep_us(uint32_t us) {
    usleep(us);
}
```

## src/tui.c
```c
/**
 * tui.c
 *
 * Terminal-Schicht: Frame-Puffer + ANSI-Escape-Ausgabe + Tastatur-
 * Parsing. Plattformspezifisches I/O (Raw-Mode, Byte lesen/schreiben,
 * Fenstergroesse) liegt hinter tui_io.h - implementiert fuer POSIX
 * (tui_io_posix.c) und Zephyr (tui_io_zephyr.c).
 *
 * Der Frame wird in einem Zellenpuffer aufgebaut und mit einem einzigen
 * write ausgegeben; Attributwechsel werden dabei minimiert.
 */

#include "tui.h"
#include "tui_io.h"

#include <stdio.h>
#include <stdlib.h>
#include <string.h>

/* Puffergroesse: im Zephyr-Build auf die konfigurierte UI-Groesse
 * begrenzt (statische Puffer!), am Host grosszuegig fuer jedes
 * Terminalfenster. */
#ifdef CONFIG_CANBOSS_TUI_ROWS
#define TUI_MAX_ROWS CONFIG_CANBOSS_TUI_ROWS
#define TUI_MAX_COLS CONFIG_CANBOSS_TUI_COLS
#else
#define TUI_MAX_ROWS 200
#define TUI_MAX_COLS 400
#endif

typedef struct {
    char ch;
    uint8_t style;
} tui_cell_t;

static bool tui_active = false;
static int tui_cur_rows = 24;
static int tui_cur_cols = 80;
static tui_cell_t tui_buf[TUI_MAX_ROWS][TUI_MAX_COLS];

static void
tui_update_size(void) {
    int rows = tui_cur_rows;
    int cols = tui_cur_cols;
    tui_io_get_size(&rows, &cols);
    tui_cur_rows = rows > 0 ? (rows < TUI_MAX_ROWS ? rows : TUI_MAX_ROWS) : tui_cur_rows;
    tui_cur_cols = cols > 0 ? (cols < TUI_MAX_COLS ? cols : TUI_MAX_COLS) : tui_cur_cols;
}

int
tui_init(void) {
    if (tui_io_init() != 0) {
        return -1;
    }
    /* Alternate Screen an, Cursor aus */
    tui_io_write("\x1b[?1049h\x1b[?25l", 14);
    tui_active = true;
    tui_update_size();
    return 0;
}

void
tui_deinit(void) {
    if (!tui_active) {
        return;
    }
    tui_io_write("\x1b[?25h\x1b[?1049l", 14);
    tui_io_deinit();
    tui_active = false;
}

int
tui_rows(void) {
    return tui_cur_rows;
}

int
tui_cols(void) {
    return tui_cur_cols;
}

void
tui_frame_begin(void) {
    tui_update_size();
    for (int r = 0; r < tui_cur_rows; r++) {
        for (int c = 0; c < tui_cur_cols; c++) {
            tui_buf[r][c].ch = ' ';
            tui_buf[r][c].style = CB_ST_NONE;
        }
    }
}

static size_t
emit_style(char* out, uint8_t style) {
    size_t n = 0;
    n += (size_t)sprintf(out + n, "\x1b[0m");
    if (style & CB_ST_BOLD) {
        n += (size_t)sprintf(out + n, "\x1b[1m");
    }
    if (style & CB_ST_DIM) {
        n += (size_t)sprintf(out + n, "\x1b[2m");
    }
    if (style & CB_ST_REVERSE) {
        n += (size_t)sprintf(out + n, "\x1b[7m");
    }
    if (style & CB_ST_CYAN) {
        n += (size_t)sprintf(out + n, "\x1b[36m");
    }
    if (style & CB_ST_YELLOW) {
        n += (size_t)sprintf(out + n, "\x1b[33m");
    }
    return n;
}

void
tui_frame_flush(void) {
    /* Worst case: je Zelle ein Attributwechsel (~24 Byte) */
    static char out[TUI_MAX_ROWS * TUI_MAX_COLS * 26 + 64];
    size_t n = 0;
    uint8_t cur_style = 0xFF;

    n += (size_t)sprintf(out + n, "\x1b[H");
    for (int r = 0; r < tui_cur_rows; r++) {
        if (r > 0) {
            n += (size_t)sprintf(out + n, "\r\n");
        }
        for (int c = 0; c < tui_cur_cols; c++) {
            if (tui_buf[r][c].style != cur_style) {
                cur_style = tui_buf[r][c].style;
                n += emit_style(out + n, cur_style);
            }
            out[n++] = tui_buf[r][c].ch;
        }
    }
    n += (size_t)sprintf(out + n, "\x1b[0m");
    tui_io_write(out, n);
}

void
tui_put(int row, int col, uint8_t style, const char* text) {
    if (row < 0 || row >= tui_cur_rows || text == NULL) {
        return;
    }
    for (int c = col; *text != '\0'; text++, c++) {
        if (c < 0) {
            continue;
        }
        if (c >= tui_cur_cols) {
            break;
        }
        /* Nicht druckbare Zeichen (auch UTF-8-Folgebytes) ersetzen,
         * damit der Zellenpuffer spaltenstabil bleibt. */
        unsigned char ch = (unsigned char)*text;
        tui_buf[row][c].ch = (ch >= 0x20 && ch < 0x7F) ? (char)ch : '?';
        tui_buf[row][c].style = style;
    }
}

void
tui_box(int row, int col, int height, int width, uint8_t style, const char* title) {
    if (height < 2 || width < 2) {
        return;
    }

    for (int c = col; c < col + width && c < tui_cur_cols; c++) {
        if (row >= 0 && row < tui_cur_rows) {
            tui_buf[row][c].ch = '-';
            tui_buf[row][c].style = style;
        }
        int bottom = row + height - 1;
        if (bottom >= 0 && bottom < tui_cur_rows) {
            tui_buf[bottom][c].ch = '-';
            tui_buf[bottom][c].style = style;
        }
    }
    for (int r = row; r < row + height && r < tui_cur_rows; r++) {
        if (r < 0) {
            continue;
        }
        if (col >= 0 && col < tui_cur_cols) {
            tui_buf[r][col].ch = '|';
            tui_buf[r][col].style = style;
        }
        int right = col + width - 1;
        if (right >= 0 && right < tui_cur_cols) {
            tui_buf[r][right].ch = '|';
            tui_buf[r][right].style = style;
        }
    }
    if (row >= 0 && row < tui_cur_rows) {
        if (col >= 0 && col < tui_cur_cols) {
            tui_buf[row][col].ch = '+';
        }
        if (col + width - 1 < tui_cur_cols) {
            tui_buf[row][col + width - 1].ch = '+';
        }
    }
    if (row + height - 1 >= 0 && row + height - 1 < tui_cur_rows) {
        if (col >= 0 && col < tui_cur_cols) {
            tui_buf[row + height - 1][col].ch = '+';
        }
        if (col + width - 1 < tui_cur_cols) {
            tui_buf[row + height - 1][col + width - 1].ch = '+';
        }
    }

    if (title != NULL && title[0] != '\0') {
        char buf[256];
        snprintf(buf, sizeof(buf), " %s ", title);
        int maxlen = width - 4;
        if (maxlen > 0 && (int)strlen(buf) > maxlen) {
            buf[maxlen] = '\0';
        }
        tui_put(row, col + 2, style | CB_ST_CYAN | CB_ST_BOLD, buf);
    }
}

cb_key_t
tui_poll_key(int timeout_ms) {
    cb_key_t key = {CB_KEY_NONE, 0};

    int c = tui_io_getc(timeout_ms);
    if (c < 0) {
        return key;
    }

    switch (c) {
        case 0x03:
            key.kind = CB_KEY_CTRL_C;
            return key;
        case '\r':
        case '\n':
            key.kind = CB_KEY_ENTER;
            return key;
        case '\t':
            key.kind = CB_KEY_TAB;
            return key;
        case 0x7F:
        case 0x08:
            key.kind = CB_KEY_BACKSPACE;
            return key;
        case 0x1B:
            break; /* Escape-Sequenz unten */
        default:
            if (c >= 0x20 && c < 0x7F) {
                key.kind = CB_KEY_CHAR;
                key.ch = (char)c;
            }
            return key;
    }

    /* ESC: entweder allein oder Beginn einer CSI-Sequenz
     * (20 ms auf Folgebytes warten) */
    int b1 = tui_io_getc(20);
    if (b1 != '[') {
        key.kind = CB_KEY_ESC;
        return key;
    }
    int b2 = tui_io_getc(20);

    switch (b2) {
        case 'A': key.kind = CB_KEY_UP; break;
        case 'B': key.kind = CB_KEY_DOWN; break;
        case 'C': key.kind = CB_KEY_RIGHT; break;
        case 'D': key.kind = CB_KEY_LEFT; break;
        case 'Z': key.kind = CB_KEY_TAB; break; /* Shift-Tab wie Tab */
        default: key.kind = CB_KEY_ESC; break;
    }
    return key;
}
```

## src/tui_io_posix.c
```c
/**
 * tui_io_posix.c
 *
 * Terminal-I/O fuer Linux/POSIX: termios-Raw-Mode, select auf stdin,
 * Fenstergroesse per TIOCGWINSZ. (Beim Zephyr-Build ersetzt durch
 * tui_io_zephyr.c.)
 */

#include "tui_io.h"

#include <stdbool.h>
#include <sys/ioctl.h>
#include <sys/select.h>
#include <termios.h>
#include <unistd.h>

static struct termios tui_saved_termios;
static bool tui_raw_active = false;

int
tui_io_init(void) {
    struct termios raw;

    if (tcgetattr(STDIN_FILENO, &tui_saved_termios) != 0) {
        return -1;
    }
    raw = tui_saved_termios;
    raw.c_lflag &= ~(tcflag_t)(ECHO | ICANON | ISIG | IEXTEN);
    raw.c_iflag &= ~(tcflag_t)(IXON | ICRNL | BRKINT | INPCK | ISTRIP);
    raw.c_oflag &= ~(tcflag_t)OPOST;
    raw.c_cc[VMIN] = 0;
    raw.c_cc[VTIME] = 0;
    if (tcsetattr(STDIN_FILENO, TCSAFLUSH, &raw) != 0) {
        return -1;
    }
    tui_raw_active = true;
    return 0;
}

void
tui_io_deinit(void) {
    if (tui_raw_active) {
        tcsetattr(STDIN_FILENO, TCSAFLUSH, &tui_saved_termios);
        tui_raw_active = false;
    }
}

int
tui_io_getc(int timeout_ms) {
    fd_set rfds;
    struct timeval tv;

    FD_ZERO(&rfds);
    FD_SET(STDIN_FILENO, &rfds);
    tv.tv_sec = timeout_ms / 1000;
    tv.tv_usec = (timeout_ms % 1000) * 1000;

    if (select(STDIN_FILENO + 1, &rfds, NULL, NULL, &tv) <= 0) {
        return -1;
    }

    unsigned char c;
    if (read(STDIN_FILENO, &c, 1) != 1) {
        return -1;
    }
    return c;
}

void
tui_io_write(const char* buf, size_t len) {
    size_t off = 0;
    while (off < len) {
        ssize_t n = write(STDOUT_FILENO, buf + off, len - off);
        if (n <= 0) {
            return;
        }
        off += (size_t)n;
    }
}

void
tui_io_get_size(int* rows, int* cols) {
    struct winsize ws;
    if (ioctl(STDOUT_FILENO, TIOCGWINSZ, &ws) == 0 && ws.ws_row > 0 && ws.ws_col > 0) {
        *rows = ws.ws_row;
        *cols = ws.ws_col;
    }
}
```

## src/tui_io_zephyr.c
```c
/**
 * tui_io_zephyr.c
 *
 * Terminal-I/O fuer Zephyr: die UART-Konsole (chosen zephyr,console)
 * im Poll-Betrieb. Auf native_sim liegt sie mit
 * CONFIG_NATIVE_UART_0_ON_STDINOUT direkt auf stdin/stdout des
 * Host-Prozesses; auf Hardware ist die UART ohnehin "raw".
 *
 * Die Terminalgroesse ist nicht abfragbar und kommt aus
 * CONFIG_CANBOSS_TUI_{ROWS,COLS}.
 */

#ifdef CONFIG_NATIVE_LIBC
/* native_sim mit Host-libc: Feature-Makros fuer <termios.h>, muessen
 * vor dem ersten libc-Include stehen. */
#define _POSIX_C_SOURCE 200809L
#define _DEFAULT_SOURCE
#endif

#include "tui_io.h"

#include <zephyr/device.h>
#include <zephyr/drivers/uart.h>
#include <zephyr/kernel.h>

#ifdef CONFIG_NATIVE_LIBC
#include <stdbool.h>
#include <termios.h>
#include <unistd.h>
#endif

static const struct device* const tui_uart = DEVICE_DT_GET(DT_CHOSEN(zephyr_console));

#ifdef CONFIG_NATIVE_LIBC
/* Der native UART-Treiber setzt nur sein eigenes PTY in den Raw-Mode
 * (NATIVE_UART_0_ON_OWN_PTY); liegt die Konsole per
 * NATIVE_UART_0_ON_STDINOUT auf stdin/stdout, buffert das
 * Host-Terminal sonst zeilenweise und echot die Eingabe. */
static struct termios tui_saved_termios;
static bool tui_raw_active;

static void
tui_host_raw_mode(void) {
    struct termios raw;

    if (!isatty(STDIN_FILENO) || tcgetattr(STDIN_FILENO, &tui_saved_termios) != 0) {
        return;
    }
    raw = tui_saved_termios;
    raw.c_lflag &= ~(tcflag_t)(ECHO | ICANON | ISIG | IEXTEN);
    raw.c_iflag &= ~(tcflag_t)(IXON | ICRNL);
    raw.c_cc[VMIN] = 0;
    raw.c_cc[VTIME] = 0;
    if (tcsetattr(STDIN_FILENO, TCSANOW, &raw) == 0) {
        tui_raw_active = true;
    }
}

static void
tui_host_restore_mode(void) {
    if (tui_raw_active) {
        tcsetattr(STDIN_FILENO, TCSANOW, &tui_saved_termios);
        tui_raw_active = false;
    }
}
#endif /* CONFIG_NATIVE_LIBC */

int
tui_io_init(void) {
    if (!device_is_ready(tui_uart)) {
        return -1;
    }
#ifdef CONFIG_NATIVE_LIBC
    tui_host_raw_mode();
#endif
    return 0;
}

void
tui_io_deinit(void) {
#ifdef CONFIG_NATIVE_LIBC
    tui_host_restore_mode();
#endif
}

int
tui_io_getc(int timeout_ms) {
    int64_t deadline = k_uptime_get() + timeout_ms;
    unsigned char c;

    for (;;) {
        if (uart_poll_in(tui_uart, &c) == 0) {
            return c;
        }
        if (k_uptime_get() >= deadline) {
            return -1;
        }
        k_sleep(K_MSEC(1));
    }
}

void
tui_io_write(const char* buf, size_t len) {
    for (size_t i = 0; i < len; i++) {
        uart_poll_out(tui_uart, (unsigned char)buf[i]);
    }
}

void
tui_io_get_size(int* rows, int* cols) {
    *rows = CONFIG_CANBOSS_TUI_ROWS;
    *cols = CONFIG_CANBOSS_TUI_COLS;
}
```
