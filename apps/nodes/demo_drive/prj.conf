## CMakeLists.txt
```
# Demo-Knoten "Antrieb" (Node 32) - CANopenNode-Slave mit Simulation.
#   west build -b native_sim/native/64 CANboss/apps/nodes/demo_drive
cmake_minimum_required(VERSION 3.20.0)
find_package(Zephyr REQUIRED HINTS $ENV{ZEPHYR_BASE})
project(canboss_demo_drive LANGUAGES C)

set(NODE_OD demo_drive)
include(${CMAKE_CURRENT_SOURCE_DIR}/../common/node.cmake)
```

## Kconfig
```
mainmenu "CANboss Demo-Knoten Antrieb"

config DEMO_NODE_ID
	int "CANopen-Node-ID"
	range 1 127
	default 32

source "Kconfig.zephyr"
```

## prj.conf
```kconfig
# Demo-Knoten "Antrieb": CANopenNode-Slave + Prozesswert-Simulation
CONFIG_CAN=y
CONFIG_MAIN_STACK_SIZE=8192
CONFIG_BOOT_BANNER=n
```

## boards/native_sim_native_64.overlay
```dts
/*
 * Demo-Knoten haengen standardmaessig am Host-SocketCAN (vcan0) -
 * dafuer sind sie da. Interface anlegen:
 *   sudo ip link add dev vcan0 type vcan && sudo ip link set vcan0 up
 * Anderes Interface: ./zephyr.exe -can-if=<name>
 * Ohne Kernel-CAN (CI): -DEXTRA_DTC_OVERLAY_FILE=overlays/loopback.overlay
 */

/ {
	chosen {
		zephyr,canbus = &can0;
	};
};

&can0 {
	status = "okay";
	host-interface = "vcan0";
};
```

## src/main.c
```c
/**
 * Demo-Knoten "Antrieb" (Node 32, eds/demo_drive.eds, CiA402-Teilmenge).
 *
 * Simulation:
 *  - Drehzahl-Demand faehrt eine Rampe auf den vl target velocity
 *    (0x6042, per SDO/RPDO beschreibbar), sofern das Controlword
 *    (0x6040) Bit 0 (Switch On) gesetzt hat; sonst Rampe auf 0
 *  - Istdrehzahl = Demand + kleines Rauschen
 *  - Motorstrom ~ |Drehzahl|, Endstufentemperatur folgt dem Strom
 *  - Statusword: Bit 2 (Operation enabled) spiegelt das Controlword,
 *    Bremse aktiv solange Drehzahl 0 und nicht freigegeben
 */

#include <math.h>
#include <stdlib.h>

#include "node_app.h"
#include "demo_drive.h"

#define RAMPE_PRO_TICK 10 /* Drehzahlaenderung je 100 ms */

static void
sim(uint32_t t_ms) {
    bool freigabe = (demo_drive_RAM.x6040_controlword & 0x0001u) != 0;
    int16_t ziel = freigabe ? demo_drive_PERSIST_COMM.x6042_vlTargetVelocity : 0;

    int16_t demand = demo_drive_RAM.x6043_vlVelocityDemand;
    int32_t diff = (int32_t)ziel - demand;
    if (diff > RAMPE_PRO_TICK) {
        diff = RAMPE_PRO_TICK;
    } else if (diff < -RAMPE_PRO_TICK) {
        diff = -RAMPE_PRO_TICK;
    }
    demand = (int16_t)(demand + diff);

    demo_drive_RAM.x6043_vlVelocityDemand = demand;
    demo_drive_RAM.x6044_vlVelocityActualValue = (int16_t)(demand + (int)(t_ms / 100u % 3u) - 1);
    demo_drive_RAM.x2200_motorstromMA = 50 + 2 * abs((int)demand);
    demo_drive_RAM.x2202_temperaturEndstufe = 35.0f + (float)abs((int)demand) / 50.0f;
    demo_drive_RAM.x2201_bremseAktiv = (demand == 0 && !freigabe);
    demo_drive_RAM.x6041_statusword = (uint16_t)(freigabe ? 0x0027u : 0x0021u);
}

int
main(void) {
    static CO_config_t config;
    demo_drive_INIT_CONFIG(config);

    node_app_run("demo_drive", demo_drive, &config, CONFIG_DEMO_NODE_ID, sim, NULL);
    return 0;
}
```
