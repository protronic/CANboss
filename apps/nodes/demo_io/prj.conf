## CMakeLists.txt
```
# Demo-Knoten "IO-Modul" (Node 16) - CANopenNode-Slave mit Simulation.
#   west build -b native_sim/native/64 CANboss/apps/nodes/demo_io
cmake_minimum_required(VERSION 3.20.0)
find_package(Zephyr REQUIRED HINTS $ENV{ZEPHYR_BASE})
project(canboss_demo_io LANGUAGES C)

set(NODE_OD demo_io)
include(${CMAKE_CURRENT_SOURCE_DIR}/../common/node.cmake)
```

## Kconfig
```
mainmenu "CANboss Demo-Knoten IO-Modul"

config DEMO_NODE_ID
	int "CANopen-Node-ID"
	range 1 127
	default 16

source "Kconfig.zephyr"
```

## prj.conf
```kconfig
# Demo-Knoten "IO-Modul": CANopenNode-Slave + Prozesswert-Simulation
CONFIG_CAN=y
CONFIG_MAIN_STACK_SIZE=8192
CONFIG_BOOT_BANNER=n
```

## src/main.c
```c
/**
 * Demo-Knoten "IO-Modul" (Node 16, eds/demo_io.eds).
 *
 * Simulation:
 *  - digitale Eingaenge D1..D4 spiegeln die digitalen Ausgaenge 1..4
 *    (die der Master per TPDO 0x2210 bzw. SDO setzt) - so ist die
 *    Wirkung von Schreibzugriffen direkt beobachtbar
 *  - analoge Eingaenge 1..4: Sinus/Saegezahn im EDS-Bereich +-1000
 *  - Temperatur pendelt um 22 GradC, angezogen vom Sollwert (0x2101)
 */

#include <math.h>

#include "node_app.h"
#include "demo_io.h"

static void
sim(uint32_t t_ms) {
    float t = (float)t_ms / 1000.0f;

    for (int i = 0; i < 4; i++) {
        demo_io_RAM.x2003_digitaleEingaenge[i] = demo_io_RAM.x2000_digitaleAusgaenge[i];
    }

    demo_io_RAM.x2001_analogeEingaenge[0] = (int16_t)(1000.0f * sinf(t * 0.5f));
    demo_io_RAM.x2001_analogeEingaenge[1] = (int16_t)(1000.0f * sinf(t * 0.2f + 1.0f));
    demo_io_RAM.x2001_analogeEingaenge[2] = (int16_t)((int)(t * 100.0f) % 2000 - 1000); /* Saegezahn */
    demo_io_RAM.x2001_analogeEingaenge[3] = demo_io_RAM.x2101_sollwert;                 /* folgt dem Sollwert */

    float ziel = 22.0f + (float)demo_io_RAM.x2101_sollwert / 100.0f;
    demo_io_RAM.x2100_temperatur += (ziel - demo_io_RAM.x2100_temperatur) * 0.05f;
    demo_io_RAM.x2100_temperatur += 0.2f * sinf(t * 1.3f);
}

int
main(void) {
    static CO_config_t config;
    demo_io_INIT_CONFIG(config);

    node_app_run("demo_io", demo_io, &config, CONFIG_DEMO_NODE_ID, sim, NULL);
    return 0;
}
```
