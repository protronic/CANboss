## CMakeLists.txt
```
# USB-Bring-up-Demo fuer STM32H573I-DK: CDC-ACM + Zephyr-Shell + Berry-GPIO.
#
#   west build -b stm32h573i_dk CANboss/apps/usbdemo -d build-usbdemo
#   west flash -d build-usbdemo
#
# ST-Link-VCP (115200): Logs + uart:~$  (berry led(0, true))
# User-USB CN17:        1209:0001, zweite Shell usb:~$ wenn Enumeration klappt

cmake_minimum_required(VERSION 3.20.0)
find_package(Zephyr REQUIRED HINTS $ENV{ZEPHYR_BASE})
project(canboss_usbdemo LANGUAGES C)

set(REPO_ROOT ${CMAKE_CURRENT_SOURCE_DIR}/../..)
set(BERRY_DIR ${REPO_ROOT}/modules/berry)
set(BERRY_OD_DIR ${REPO_ROOT}/lib/berry_od)
set(BERRY_GEN ${BERRY_DIR}/generate)

file(GLOB berry_core_sources ${BERRY_DIR}/src/*.c)

add_custom_command(
    OUTPUT ${BERRY_GEN}/be_const_strtab.h
    COMMAND ${CMAKE_COMMAND} -E make_directory ${BERRY_GEN}
    COMMAND ${PYTHON_EXECUTABLE} ${BERRY_DIR}/tools/coc/coc
            ${BERRY_DIR}/src ${BERRY_DIR}/default
            -o ${BERRY_GEN}
            -c ${BERRY_OD_DIR}/berry_conf.h
    DEPENDS ${BERRY_OD_DIR}/berry_conf.h ${berry_core_sources}
    WORKING_DIRECTORY ${BERRY_DIR}
    COMMENT "Berry: Konstanten-Tabellen generieren (tools/coc)"
)
add_custom_target(usbdemo_berry_gen DEPENDS ${BERRY_GEN}/be_const_strtab.h)
add_dependencies(app usbdemo_berry_gen)

target_sources(app PRIVATE
    src/main.c
    src/usb.c
    ${REPO_ROOT}/lib/usbc/usbc_h573_dk.c
    src/berry_gpio.c
    src/berry_port.c
    ${berry_core_sources}
    ${BERRY_DIR}/default/be_modtab.c
)

target_include_directories(app BEFORE PRIVATE ${BERRY_OD_DIR} src)
target_include_directories(app PRIVATE ${REPO_ROOT}/lib/usbc)

target_include_directories(app PRIVATE ${BERRY_DIR}/src)
```

## prj.conf
```kconfig
CONFIG_GPIO=y
CONFIG_SERIAL=y
CONFIG_CONSOLE=y
CONFIG_UART_CONSOLE=y
CONFIG_UART_LINE_CTRL=y
CONFIG_I2C=y
CONFIG_HWINFO=y

CONFIG_USB_DEVICE_STACK_NEXT=y
CONFIG_USBD_CDC_ACM_CLASS=y
CONFIG_USBD_CDC_ACM_WORKQUEUE=y
CONFIG_SYSTEM_WORKQUEUE_STACK_SIZE=2048

CONFIG_SHELL=y
CONFIG_DEVICE_SHELL=y
CONFIG_KERNEL_SHELL=y
CONFIG_GPIO_SHELL=y
CONFIG_I2C_SHELL=y
CONFIG_USBD_SHELL=y
CONFIG_THREAD_MONITOR=y
CONFIG_THREAD_NAME=y
CONFIG_SHELL_CMD_BUFF_SIZE=512

CONFIG_LOG=y
CONFIG_LOG_MODE_MINIMAL=y
CONFIG_BOOT_BANNER=y
CONFIG_USBD_LOG_LEVEL_INF=y
CONFIG_USBD_CDC_ACM_LOG_LEVEL_OFF=y
CONFIG_UDC_DRIVER_LOG_LEVEL_ERR=y

CONFIG_MAIN_STACK_SIZE=8192
CONFIG_COMMON_LIBC_MALLOC_ARENA_SIZE=32768
CONFIG_SHELL_STACK_SIZE=4096
```

## boards/stm32h573i_dk.conf
```kconfig
# TCPP03-M20 auf CN17 (I2C4 @ 0x34, Enable PG0)
CONFIG_I2C=y
CONFIG_I2C_SHELL=y
```

## boards/stm32h573i_dk.overlay
```dts
/*
 * USB-Demo: CDC-ACM am User-USB (CN17). Konsole/Shell bleiben auf
 * der ST-Link-VCP (usart1). Eine zweite Shell startet auf der CDC,
 * sobald der Host DTR setzt.
 */

&zephyr_udc0 {
	cdc_acm_uart0: cdc_acm_uart0 {
		compatible = "zephyr,cdc-acm-uart";
		label = "CANboss USB Demo";
	};
};
```

## src/main.c
```c
/**
 * USB-Bring-up-Demo: CDC-ACM am User-USB (CN17) plus Zephyr-Shell und
 * Berry-GPIO. Kein CAN, kein Gateway, kein CANopen.
 *
 * ST-Link CN10 /dev/ttyACM0 @ 115200: Logs + uart:~$
 * User-USB CN17: VID/PID 1209:0001, zweite Shell usb:~$ nach DTR
 */

#include <zephyr/kernel.h>
#include <zephyr/logging/log.h>

#include "berry_gpio.h"
#include "usb.h"

LOG_MODULE_REGISTER(usbdemo, LOG_LEVEL_INF);

int
main(void) {
    LOG_INF("USB-Demo startet (Shell + Berry, kein CAN)");

    usbdemo_berry_init();
    LOG_INF("Berry bereit: berry help()  oder  berry led(0, true)");

    int err = usbdemo_usb_init();
    if (err != 0) {
        LOG_ERR("USB-Init fehlgeschlagen (%d) - Shell bleibt auf ST-Link", err);
    }

    for (;;) {
        k_sleep(K_SECONDS(5));
    }
}
```

## src/berry_gpio.c
```c
/**
 * Berry-VM fuer das USB-Demo: GPIO der STM32H573I-DK (LEDs, User-Taste,
 * beliebige Ports). Kein CANopen, keine OD-Bindings.
 *
 *   led(0..3 [, on])     LD1 gruen PI9, LD2 orange PI8, LD3 rot PF1, LD4 blau PF4
 *   btn()                User-Taste PC13, true = gedrueckt
 *   pin("I", 9 [, v])    beliebiger Pin lesen/schreiben (Pegel 0/1)
 *   help()
 */

#include "berry_gpio.h"

#include <stdio.h>
#include <stdlib.h>
#include <string.h>

#include <zephyr/device.h>
#include <zephyr/devicetree.h>
#include <zephyr/drivers/gpio.h>
#include <zephyr/kernel.h>
#include <zephyr/shell/shell.h>

#include "berry.h"

static bvm* g_vm;
static struct k_mutex g_vm_lock;

static const struct gpio_dt_spec leds[] = {
    GPIO_DT_SPEC_GET(DT_NODELABEL(green_led_0), gpios),
    GPIO_DT_SPEC_GET(DT_NODELABEL(orange_led_0), gpios),
    GPIO_DT_SPEC_GET(DT_NODELABEL(red_led_0), gpios),
    GPIO_DT_SPEC_GET(DT_NODELABEL(blue_led_0), gpios),
};

static const struct gpio_dt_spec user_btn = GPIO_DT_SPEC_GET(DT_NODELABEL(user_button), gpios);

static const struct device*
port_dev(char letter) {
    switch (letter) {
    case 'A':
    case 'a':
        return DEVICE_DT_GET(DT_NODELABEL(gpioa));
    case 'B':
    case 'b':
        return DEVICE_DT_GET(DT_NODELABEL(gpiob));
    case 'C':
    case 'c':
        return DEVICE_DT_GET(DT_NODELABEL(gpioc));
    case 'D':
    case 'd':
        return DEVICE_DT_GET(DT_NODELABEL(gpiod));
    case 'E':
    case 'e':
        return DEVICE_DT_GET(DT_NODELABEL(gpioe));
    case 'F':
    case 'f':
        return DEVICE_DT_GET(DT_NODELABEL(gpiof));
    case 'G':
    case 'g':
        return DEVICE_DT_GET(DT_NODELABEL(gpiog));
    case 'H':
    case 'h':
        return DEVICE_DT_GET(DT_NODELABEL(gpioh));
    case 'I':
    case 'i':
        return DEVICE_DT_GET(DT_NODELABEL(gpioi));
    default:
        return NULL;
    }
}

static int
raise_type(bvm* vm, const char* msg) {
    be_raise(vm, "type_error", msg);
    be_return_nil(vm);
}

static int
m_led(bvm* vm) {
    int argc = be_top(vm);

    if (argc < 1 || !be_isint(vm, 1)) {
        return raise_type(vm, "led(n [, on])  n=0..3");
    }

    int n = (int)be_toint(vm, 1);
    if (n < 0 || n >= (int)ARRAY_SIZE(leds)) {
        return raise_type(vm, "led: n muss 0..3 sein (LD1..LD4)");
    }

    if (!gpio_is_ready_dt(&leds[n])) {
        return raise_type(vm, "led: GPIO nicht bereit");
    }

    (void)gpio_pin_configure_dt(&leds[n], GPIO_OUTPUT_INACTIVE);

    if (argc >= 2) {
        bool on = be_isbool(vm, 2) ? (bool)be_tobool(vm, 2) : (be_toint(vm, 2) != 0);
        (void)gpio_pin_set_dt(&leds[n], on ? 1 : 0);
        be_pushbool(vm, on);
        be_return(vm);
    }

    int v = gpio_pin_get_dt(&leds[n]);
    be_pushbool(vm, v > 0);
    be_return(vm);
}

static int
m_btn(bvm* vm) {
    if (!gpio_is_ready_dt(&user_btn)) {
        return raise_type(vm, "btn: GPIO nicht bereit");
    }

    (void)gpio_pin_configure_dt(&user_btn, GPIO_INPUT);
    be_pushbool(vm, gpio_pin_get_dt(&user_btn) > 0);
    be_return(vm);
}

static int
m_pin(bvm* vm) {
    int argc = be_top(vm);

    if (argc < 2 || !be_isstring(vm, 1) || !be_isint(vm, 2)) {
        return raise_type(vm, "pin(\"A\"..\"I\", n [, v])");
    }

    const char* port = be_tostring(vm, 1);
    if (port[0] == '\0' || port[1] != '\0') {
        return raise_type(vm, "pin: Port ist ein Buchstabe A..I");
    }

    int pin = (int)be_toint(vm, 2);
    if (pin < 0 || pin > 15) {
        return raise_type(vm, "pin: n muss 0..15 sein");
    }

    const struct device* dev = port_dev(port[0]);
    if (dev == NULL || !device_is_ready(dev)) {
        return raise_type(vm, "pin: Port unbekannt oder nicht bereit");
    }

    if (argc >= 3) {
        int v = be_isbool(vm, 3) ? (be_tobool(vm, 3) ? 1 : 0) : (int)be_toint(vm, 3);
        if (gpio_pin_configure(dev, (gpio_pin_t)pin, GPIO_OUTPUT) != 0) {
            return raise_type(vm, "pin: Configure als Ausgang fehlgeschlagen");
        }
        (void)gpio_pin_set(dev, (gpio_pin_t)pin, v ? 1 : 0);
        be_pushint(vm, v ? 1 : 0);
        be_return(vm);
    }

    if (gpio_pin_configure(dev, (gpio_pin_t)pin, GPIO_INPUT) != 0) {
        return raise_type(vm, "pin: Configure als Eingang fehlgeschlagen");
    }
    be_pushint(vm, gpio_pin_get(dev, (gpio_pin_t)pin) > 0 ? 1 : 0);
    be_return(vm);
}

static int
m_help(bvm* vm) {
    static const char help[] =
        "Berry " BERRY_VERSION " auf STM32H573I-DK (USB-Demo, kein CAN)\n"
        "\n"
        "  led(0..3 [, on])     LD1 gruen, LD2 orange, LD3 rot, LD4 blau\n"
        "  btn()                User-Taste, true = gedrueckt\n"
        "  pin(\"I\", 9 [, v])    Port A..I, Pin 0..15 lesen/schreiben\n"
        "  help()\n"
        "\n"
        "Beispiele:\n"
        "  led(0, true)         LD1 an\n"
        "  led(3, false)        LD4 aus\n"
        "  print(btn())         Taste?\n"
        "  pin(\"I\", 9, 0)       PI9 low (LD1-Anode, ACTIVE_LOW = LED an)\n"
        "\n"
        "Nicht anfassen: PA11/PA12 (USB), PG0 (TCPP), PB8/PB9 (I2C4).\n"
        "REPL: 'berry' ohne Argumente, Ende mit exit / quit / Strg-D.\n";

    be_writebuffer(help, strlen(help));
    be_return_nil(vm);
}

int
usbdemo_berry_exec(const char* code) {
    if (g_vm == NULL || code == NULL) {
        return -1;
    }

    k_mutex_lock(&g_vm_lock, K_FOREVER);

    int ret;
    size_t n = strlen(code) + 16;
    char* expr = malloc(n);
    if (expr != NULL) {
        snprintf(expr, n, "return (%s)", code);
        ret = be_loadstring(g_vm, expr);
        free(expr);
        if (ret != 0) {
            be_pop(g_vm, 1);
            ret = be_loadstring(g_vm, code);
        }
    } else {
        ret = be_loadstring(g_vm, code);
    }

    if (ret == 0) {
        ret = be_pcall(g_vm, 0);
    }

    if (ret != 0) {
        be_dumpexcept(g_vm);
    } else {
        if (!be_isnil(g_vm, -1)) {
            const char* s = be_tostring(g_vm, -1);
            be_writebuffer(s, strlen(s));
            be_writebuffer("\n", 1);
        }
        be_pop(g_vm, 1);
    }

    k_mutex_unlock(&g_vm_lock);
    return ret == 0 ? 0 : -1;
}

void
usbdemo_berry_init(void) {
    if (g_vm != NULL) {
        return;
    }

    k_mutex_init(&g_vm_lock);
    g_vm = be_vm_new();
    be_regfunc(g_vm, "led", m_led);
    be_regfunc(g_vm, "btn", m_btn);
    be_regfunc(g_vm, "pin", m_pin);
    be_regfunc(g_vm, "help", m_help);
}

static void
shell_sink(void* user, const char* buf, size_t len) {
    const struct shell* sh = user;
    shell_fprintf(sh, SHELL_NORMAL, "%.*s", (int)len, buf);
}

#define REPL_LINE_MAX 256

struct berry_repl {
    const struct shell* sh;
    char line[REPL_LINE_MAX];
    size_t pos;
};

static struct berry_repl g_repl;

static void
repl_prompt(const struct shell* sh) {
    shell_fprintf(sh, SHELL_NORMAL, "berry> ");
}

static void
repl_stop(const struct shell* sh) {
    shell_set_bypass(sh, NULL, NULL);
    usbdemo_berry_set_sink(NULL, NULL);
    shell_print(sh, "Berry-REPL beendet");
}

static void
repl_run_line(struct berry_repl* r) {
    r->line[r->pos] = '\0';
    r->pos = 0;

    if (r->line[0] == '\0') {
        repl_prompt(r->sh);
        return;
    }
    if (strcmp(r->line, "exit") == 0 || strcmp(r->line, "quit") == 0) {
        repl_stop(r->sh);
        return;
    }

    usbdemo_berry_set_sink(shell_sink, (void*)r->sh);
    (void)usbdemo_berry_exec(r->line);
    repl_prompt(r->sh);
}

static void
repl_bypass(const struct shell* sh, uint8_t* data, size_t len, void* user) {
    struct berry_repl* r = user;

    ARG_UNUSED(sh);
    for (size_t i = 0; i < len; i++) {
        uint8_t c = data[i];

        if (c == 0x04 && r->pos == 0) {
            repl_stop(r->sh);
            return;
        }
        if (c == '\r') {
            continue;
        }
        if (c == '\n') {
            shell_fprintf(r->sh, SHELL_NORMAL, "\n");
            repl_run_line(r);
            continue;
        }
        if (c == '\b' || c == 0x7f) {
            if (r->pos > 0) {
                r->pos--;
                shell_fprintf(r->sh, SHELL_NORMAL, "\b \b");
            }
            continue;
        }
        if (c < 32 || r->pos + 1 >= sizeof(r->line)) {
            continue;
        }
        r->line[r->pos++] = (char)c;
        shell_fprintf(r->sh, SHELL_NORMAL, "%c", c);
    }
}

static int
cmd_berry(const struct shell* sh, size_t argc, char** argv) {
    if (argc < 2 || strcmp(argv[1], "repl") == 0) {
        g_repl.sh = sh;
        g_repl.pos = 0;
        usbdemo_berry_set_sink(shell_sink, (void*)sh);
        shell_print(sh, "Berry-REPL (exit / quit / Strg-D). help() zeigt GPIO-API.");
        repl_prompt(sh);
        shell_set_bypass(sh, repl_bypass, &g_repl);
        return 0;
    }

    static char code[CONFIG_SHELL_CMD_BUFF_SIZE];
    code[0] = '\0';
    size_t pos = 0;
    for (size_t i = 1; i < argc; i++) {
        int w = snprintf(code + pos, sizeof(code) - pos, "%s%s", i > 1 ? " " : "", argv[i]);
        if (w < 0 || (size_t)w >= sizeof(code) - pos) {
            break;
        }
        pos += (size_t)w;
    }

    usbdemo_berry_set_sink(shell_sink, (void*)sh);
    int ret = usbdemo_berry_exec(code);
    usbdemo_berry_set_sink(NULL, NULL);
    return ret;
}

SHELL_CMD_ARG_REGISTER(berry, NULL,
                       "Berry: 'berry' startet REPL, 'berry led(0, true)' Einzeiler",
                       cmd_berry, 1, 32);
```

## src/berry_gpio.h
```c
#pragma once

#include <stddef.h>

void usbdemo_berry_init(void);
int usbdemo_berry_exec(const char* code);

typedef void (*usbdemo_berry_sink_t)(void* user, const char* buf, size_t len);

void usbdemo_berry_set_sink(usbdemo_berry_sink_t sink, void* user);
```

## src/berry_port.c
```c
/**
 * Minimaler Berry-Port (kein Dateisystem, Ausgabe an umschaltbare Senke).
 */

#include "berry.h"
#include "berry_gpio.h"

#include <stdio.h>

static usbdemo_berry_sink_t cb_sink;
static void* cb_sink_user;

void
usbdemo_berry_set_sink(usbdemo_berry_sink_t sink, void* user) {
    cb_sink = sink;
    cb_sink_user = user;
}

BERRY_API void
be_writebuffer(const char* buffer, size_t length) {
    if (cb_sink != NULL) {
        cb_sink(cb_sink_user, buffer, length);
    } else {
        fwrite(buffer, 1, length, stdout);
    }
}

BERRY_API char*
be_readstring(char* buffer, size_t size) {
    (void)buffer;
    (void)size;
    return NULL;
}

void*
be_fopen(const char* filename, const char* modes) {
    (void)filename;
    (void)modes;
    return NULL;
}

int
be_fclose(void* hfile) {
    (void)hfile;
    return -1;
}

size_t
be_fwrite(void* hfile, const void* buffer, size_t length) {
    if (hfile == stdout || hfile == stderr) {
        be_writebuffer(buffer, length);
        return length;
    }
    return 0;
}

size_t
be_fread(void* hfile, void* buffer, size_t length) {
    (void)hfile;
    (void)buffer;
    (void)length;
    return 0;
}

char*
be_fgets(void* hfile, void* buffer, int size) {
    (void)hfile;
    (void)buffer;
    (void)size;
    return NULL;
}

int
be_fseek(void* hfile, long offset) {
    (void)hfile;
    (void)offset;
    return -1;
}

long int
be_ftell(void* hfile) {
    (void)hfile;
    return -1;
}

long int
be_fflush(void* hfile) {
    (void)hfile;
    return 0;
}

size_t
be_fsize(void* hfile) {
    (void)hfile;
    return 0;
}
```

## src/usb.c
```c
/**
 * USB-CDC-Bring-up fuer das H573I-DK: Dead-Battery-Rd, TCPP03-M20,
 * dann USBD-Next + CDC-ACM. Zweite Shell auf der CDC nach DTR.
 */

#include "usb.h"

#include <zephyr/device.h>
#include <zephyr/drivers/uart.h>
#include <zephyr/kernel.h>
#include <zephyr/shell/shell.h>
#include <zephyr/shell/shell_uart.h>
#include <zephyr/sys/sys_io.h>
#include <zephyr/usb/usbd.h>

#include "usbc_h573_dk.h" /* Dead-Battery-Rd + TCPP03 (CN17) */

#include <zephyr/logging/log.h>
LOG_MODULE_REGISTER(usbdemo_usb, LOG_LEVEL_INF);

#define USB_DRD_BCDR 0x40016058U

static const char* const class_blocklist[] = {
    "dfu_dfu",
    NULL,
};

USBD_DEVICE_DEFINE(demo_usbd, DEVICE_DT_GET(DT_NODELABEL(zephyr_udc0)), 0x1209, 0x0001);
USBD_DESC_LANG_DEFINE(demo_lang);
USBD_DESC_MANUFACTURER_DEFINE(demo_mfr, "Protronic GmbH");
USBD_DESC_PRODUCT_DEFINE(demo_product, "CANboss USB Demo");
USBD_DESC_SERIAL_NUMBER_DEFINE(demo_sn);
USBD_DESC_CONFIG_DEFINE(demo_fs_cfg_desc, "USB Demo");
USBD_CONFIGURATION_DEFINE(demo_fs_config, 0, 125, &demo_fs_cfg_desc);

static atomic_t cdc_shell_started;

SHELL_UART_DEFINE(cdc_transport);
SHELL_DEFINE(cdc_shell, "usb:~$ ", &cdc_transport, 256, 100, SHELL_FLAG_OLF_CRLF);

static void
usbdemo_start_cdc_shell(void) {
    const struct device* cdc = DEVICE_DT_GET(DT_NODELABEL(cdc_acm_uart0));
    static const struct shell_backend_config_flags cfg_flags =
        SHELL_DEFAULT_BACKEND_CONFIG_FLAGS;

    if (!atomic_cas(&cdc_shell_started, 0, 1)) {
        return;
    }

    if (!device_is_ready(cdc)) {
        LOG_ERR("CDC-UART nicht bereit");
        return;
    }

    if (shell_init(&cdc_shell, cdc, cfg_flags, false, 0) != 0) {
        LOG_ERR("CDC-Shell init fehlgeschlagen");
        return;
    }

    if (shell_start(&cdc_shell) != 0) {
        LOG_ERR("CDC-Shell start fehlgeschlagen");
        return;
    }

    LOG_INF("CDC-Shell bereit (usb:~$)");
}

static void
usbd_msg_cb(struct usbd_context* const ctx, const struct usbd_msg* msg) {
    LOG_INF("USBD: %s", usbd_msg_type_string(msg->type));

    if (usbd_can_detect_vbus(ctx)) {
        if (msg->type == USBD_MSG_VBUS_READY) {
            (void)usbd_enable(ctx);
        }
        if (msg->type == USBD_MSG_VBUS_REMOVED) {
            (void)usbd_disable(ctx);
        }
    }

    if (msg->type == USBD_MSG_CONFIGURATION ||
        msg->type == USBD_MSG_CDC_ACM_CONTROL_LINE_STATE) {
        usbdemo_start_cdc_shell();
    }
}

int
usbdemo_usb_init(void) {
    int err;

    (void)canboss_usbc_prepare();

    if (!device_is_ready(DEVICE_DT_GET(DT_NODELABEL(zephyr_udc0)))) {
        LOG_ERR("UDC nicht bereit");
        return -ENODEV;
    }

    err = usbd_add_descriptor(&demo_usbd, &demo_lang);
    if (err == 0) {
        err = usbd_add_descriptor(&demo_usbd, &demo_mfr);
    }
    if (err == 0) {
        err = usbd_add_descriptor(&demo_usbd, &demo_product);
    }
    if (err == 0) {
        err = usbd_add_descriptor(&demo_usbd, &demo_sn);
    }
    if (err) {
        LOG_ERR("Deskriptor abgelehnt (%d)", err);
        return err;
    }

    err = usbd_add_configuration(&demo_usbd, USBD_SPEED_FS, &demo_fs_config);
    if (err) {
        LOG_ERR("Konfiguration abgelehnt (%d)", err);
        return err;
    }

    err = usbd_register_all_classes(&demo_usbd, USBD_SPEED_FS, 1, class_blocklist);
    if (err) {
        LOG_ERR("Klassen-Registrierung fehlgeschlagen (%d)", err);
        return err;
    }

    (void)usbd_device_set_code_triple(&demo_usbd, USBD_SPEED_FS, USB_BCC_MISCELLANEOUS, 0x02,
                                      0x01);
    usbd_self_powered(&demo_usbd, false);

    err = usbd_msg_register_cb(&demo_usbd, usbd_msg_cb);
    if (err) {
        LOG_ERR("Message-Callback abgelehnt (%d)", err);
        return err;
    }

    err = usbd_init(&demo_usbd);
    if (err) {
        LOG_ERR("usbd_init fehlgeschlagen (%d)", err);
        return err;
    }

    if (!usbd_can_detect_vbus(&demo_usbd)) {
        err = usbd_enable(&demo_usbd);
        if (err) {
            LOG_ERR("usbd_enable fehlgeschlagen (%d)", err);
            return err;
        }
    }

    LOG_INF("USB-Device aktiv (VID/PID 1209:0001) BCDR=0x%08x DPPU=%d",
            sys_read32(USB_DRD_BCDR), !!(sys_read32(USB_DRD_BCDR) & USB_BCDR_DPPU));
    return 0;
}

void
usbdemo_usb_start_cdc_shell(void) {
    usbdemo_start_cdc_shell();
}
```

## src/usb.h
```c
#pragma once

int usbdemo_usb_init(void);
void usbdemo_usb_start_cdc_shell(void);
```
