## apps/monitor/Kconfig
```kconfig
# Applikationsoptionen des CANboss-Monitors (Zephyr-Build)

mainmenu "CANboss - CANopen-Parametermonitor"

config CANBOSS_NODE_ID
	int "Eigene CANopen-Node-ID des Monitors"
	range 1 127
	default 127
	help
	  Node-ID, mit der der Monitor selbst am Bus haengt
	  (canboss_master.eds: Node 127).

config CANBOSS_TUI_ROWS
	int "Zeilen der Terminal-UI"
	range 12 200
	default 30
	help
	  Die UART-Konsole kann die Terminalgroesse nicht abfragen;
	  die UI zeichnet fest mit dieser Zeilenzahl.

config CANBOSS_TUI_COLS
	int "Spalten der Terminal-UI"
	range 60 400
	default 120

source "Kconfig.zephyr"
```

## apps/touch/zephyr-app/build-touch-h573/Kconfig/Kconfig.sysbuild.modules
```kconfig
config ZEPHYR_LVGL_MODULE
   bool
   default y
config ZEPHYR_CMSIS_MODULE
   bool
   default y
config ZEPHYR_HAL_STM32_MODULE
   bool
   default y
```

## zephyr-app/build-touch-h573/Kconfig/Kconfig.modules
```kconfig
menu "lvgl (/home/user/modules/lib/gui/lvgl)"
osource "/home/user/modules/lib/gui/lvgl/zephyr/Kconfig"
config ZEPHYR_LVGL_MODULE
	bool
	default y
endmenu
menu "cmsis (/home/user/modules/hal/cmsis)"
osource "$(ZEPHYR_CMSIS_KCONFIG)"
config ZEPHYR_CMSIS_MODULE
	bool
	default y
endmenu
config ZEPHYR_HAL_STM32_MODULE
	bool
	default y

config ZEPHYR_HAL_STM32_MODULE_BLOBS
	bool
```
